AUTOSAR XML (schema 00046)
package /ARKMICRO
  module definition Wdg [0..*]: category=VENDOR_SPECIFIC_MODULE_DEFINITION, post-build-variant-support=true, refined-module-def=Wdg, variants link-time/post-build/pre-compile  # Configuration of the Wdg (Watchdog driver) module.
    container WdgDemEventParameterRefs [0..1]: multiplicity set at pre-compile  # Container for the references to DemEventParameter elements which shall be invoked using the API Dem_SetEventStatus in case the corresponding error occurs. The EventId is taken from the referenced DemEventParameter's DemEventId symbolic value. The standardized errors are provided in this container and can be extended by vendor-specific error references.
      reference WDG_E_DISABLE_REJECTED [0..1]: multiplicity set at pre-compile, set at pre-compile, requires-symbolic-name-value=true, destination=DemEventParameter  # Reference to the DemEventParameter which shall be issued when the error "Initialization or mode switch failed because it would disable the watchdog" has occurred.
      reference WDG_E_MODE_FAILED [0..1]: multiplicity set at pre-compile, set at pre-compile, requires-symbolic-name-value=true, destination=DemEventParameter  # Reference to the DemEventParameter which shall be issued when the error "Setting a watchdog mode failed (during initialization or mode switch)" has occurred.
    container WdgGeneral: multiplicity set at pre-compile  # All general parameters of the watchdog driver are collected here.
      boolean WdgDevErrorDetect: multiplicity set at pre-compile, set at pre-compile, default-value=false  # Switches the development error detection and notification on or off. | * true: detection and notification is enabled. * false: detection and notification is disabled.
      boolean WdgDisableAllowed: multiplicity set at pre-compile, set at pre-compile  # Compile switch to allow / forbid disabling the watchdog driver during runtime. | True: Disabling the watchdog driver at runtime is allowed. False: Disabling the watchdog driver at runtime is not allowed.
      integer WdgIndex: 0..255, multiplicity set at pre-compile, set at pre-compile, symbolic-name-value=true  # Specifies the InstanceId of this module instance. If only one instance is present it shall have the Id 0.
      float WdgInitialTimeout: 0..65.535, multiplicity set at pre-compile, set at pre-compile  # The initial timeout (sec) for the trigger condition to be initialized during Init function. It shall be not larger than WdgMaxTimeout.
      float WdgMaxTimeout: 0..65.535, multiplicity set at pre-compile, set at pre-compile  # The maximum timeout (sec) to which the watchdog trigger condition can be initialized.
      enumeration WdgRunArea: {RAM, ROM}, multiplicity set at pre-compile, set at pre-compile  # Represents the watchdog driver execution area is either from ROM(Flash) or RAM as required with the particular microcontroller.
      function name WdgTriggerLocation: multiplicity set at pre-compile, set at pre-compile  # Location (memory address) of the watchdog trigger routine.
      boolean WdgVersionInfoApi: multiplicity set at pre-compile, set at pre-compile, default-value=false  # Compile switch to enable / disable the version information API | * True: API enabled * False: API disabled
      reference WdgEcucPartitionRef [0..1]: scope=ECU, multiplicity set at pre-compile, post-build-variant-multiplicity=true, post-build-variant-value=true, set at pre-compile, destination=EcucPartition  # Maps the Wdg driver to zero or one ECUC partitions to make the modules API available in this partition. Tags: atp.Status=draft
    container WdgPublishedInformation: multiplicity set at pre-compile  # Container holding all Wdg specific published information parameters
      enumeration WdgTriggerMode: {WDG_BOTH, WDG_TOGGLE, WDG_WINDOW}, multiplicity set at pre-compile, set at published-information  # Watchdog trigger mode (toggle/window/both)
    container WdgSettingsConfig: multiplicity set at pre-compile  # Configuration items for the different watchdog settings, including those for external watchdog hardware. | Note: All postbuild parameters are handled via this container.
      enumeration WdgDefaultMode: {WDGIF_FAST_MODE, WDGIF_OFF_MODE, WDGIF_SLOW_MODE}, multiplicity set at pre-compile, post-build-variant-value=true, set at link in variant link-time / post-build in variant post-build / pre-compile in variant pre-compile  # Default mode for watchdog driver initialization. | ImplementationType: WdgIf_ModeType
      container WdgExternalConfiguration [0..1]: multiplicity set at pre-compile  # Configuration items for an external watchdog hardware
        choice reference WdgExternalContainerRef [0..1]: multiplicity set at link in variant link-time / post-build in variant post-build / pre-compile in variant pre-compile, post-build-variant-multiplicity=true, post-build-variant-value=true, set at link in variant link-time / post-build in variant post-build / pre-compile in variant pre-compile, destination=[DioChannelGroup, SpiSequence]  # Reference to either | - a DioChannelGroup container in case the hardware watchdog is connected via DIO pins - an SpiSequenceConfiguration container in case the watchdog hardware is accessed via SPI
      container WdgSettingsFast: multiplicity set at pre-compile  # Hardware dependent settings for the watchdog driver's "fast" mode.
      container WdgSettingsOff: multiplicity set at pre-compile  # Hardware dependent settings for the watchdog driver's "off" mode.
      container WdgSettingsSlow: multiplicity set at pre-compile  # Hardware dependent settings for the watchdog driver's "slow" mode.
  bsw implementation Wdg_Impl: programming-language=C, vendor-specific-module-def=Wdg
